## backup/sdkconfig.defaults
```kconfig
CONFIG_FREERTOS_HZ=1000

# Optional but strongly recommended for ESP32-S3-DevKitM-1 N16R8
CONFIG_SPIRAM_SUPPORT=y
CONFIG_SPIRAM_MODE_OCT=y
CONFIG_SPIRAM_SPEED_80M=y
CONFIG_SPIRAM_TYPE_AUTO=y
CONFIG_SPIRAM_SIZE=8388608
CONFIG_SPIRAM_CACHE_WORKAROUND=y
CONFIG_SPIRAM_BOOT_INIT=y
CONFIG_ESP32S3_SPIRAM_SUPPORT=y
```
